## config/boards/shields/totem/Kconfig.defconfig
```kconfig
config ZMK_SPLIT
    default y

config ZMK_KEYBOARD_NAME
    default "TOTEM"


if SHIELD_TOTEM_LEFT || SHIELD_TOTEM_RIGHT

config ZMK_SLEEP
       default y

endif
```
